## Kconfig
```kconfig
#
# For a description of the syntax of this configuration file,
# see Documentation/kbuild/kconfig-language.txt.
#
mainmenu "Linux/$ARCH $KERNELVERSION Kernel Configuration"

config SRCARCH
	string
	option env="SRCARCH"

config VENDOR_XIAOMI
	bool "XiaoMi support"
	help
		This feature enables XiaoMi specific hacks

source "arch/$SRCARCH/Kconfig"
```
